## base_external/package/aesd-assignments/Config.in
```kconfig
config BR2_PACKAGE_AESD_ASSIGNMENTS
	bool "aesd-assignments"
	help
	  Includes aesdsocket, its init script, the writer executable, finder.sh and tester.sh in the kernel image.
	  Used to understand buildroot external trees and package builds.
```
